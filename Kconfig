## Kconfig
```kconfig
menuconfig RT_USING_SPI_BITOPS
    bool "Use GPIO to simulate SPI"
    select RT_USING_SPI
    default n

if RT_USING_SPI_BITOPS
    config RT_SPI_BITOPS_DEBUG
        bool "Use simulate SPI debug mesage"
        default n
endif
```
